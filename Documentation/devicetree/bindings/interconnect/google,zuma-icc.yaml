## Documentation/devicetree/bindings/interconnect/google,zuma-icc.yaml
```yaml
# SPDX-License-Identifier: (GPL-2.0-only OR BSD-2-Clause)
%YAML 1.2
---
$id: http://devicetree.org/schemas/interconnect/google,zuma-icc.yaml#
$schema: http://devicetree.org/meta-schemas/core.yaml#

title: Google Tensor G3 (zuma) memory interconnect

maintainers:
  - Joshndroid <fmxjoshiewah@gmail.com>

description: |
  The CPU clusters and the GPU of the Google Tensor G3 vote for the memory
  (MIF), internal NoC (INT), CPU cluster interconnect (DSU) and DSU bus
  interface (BCI) buses through the interconnect framework, normally with
  opp-peak-kBps in their operating points. The provider aggregates the votes
  per bus and requests the matching minimum frequency from the bus's devfreq
  device, a samsung,exynos-bus node whose samsung,data-clock-ratio converts
  bandwidth to frequency.

  Node IDs are in dt-bindings/interconnect/google,zuma.h.

properties:
  compatible:
    const: google,zuma-icc

  '#interconnect-cells':
    const: 1

  google,buses:
    $ref: /schemas/types.yaml#/definitions/phandle-array
    items:
      - description: MIF (memory) bus
        maxItems: 1
      - description: DSU (CPU cluster interconnect) bus
        maxItems: 1
      - description: INT (internal NoC) bus
        maxItems: 1
      - description: BCI (DSU bus interface) bus
        maxItems: 1
    description:
      samsung,exynos-bus nodes that receive the aggregated votes for
      ZUMA_SLAVE_MIF, ZUMA_SLAVE_DSU, ZUMA_SLAVE_INT and ZUMA_SLAVE_BCI.

required:
  - compatible
  - '#interconnect-cells'
  - google,buses

additionalProperties: false

examples:
  - |
    interconnect {
        compatible = "google,zuma-icc";
        #interconnect-cells = <1>;
        google,buses = <&bus_mif>, <&bus_dsu>, <&bus_int>, <&bus_bci>;
    };
```

## Documentation/devicetree/bindings/regulator/dlg,slg51000.yaml
```yaml
# SPDX-License-Identifier: GPL-2.0-only OR BSD-2-Clause
%YAML 1.2
---
$id: http://devicetree.org/schemas/regulator/dlg,slg51000.yaml#
$schema: http://devicetree.org/meta-schemas/core.yaml#

title: Dialog Semiconductor SLG51000/SLG51002 Voltage Regulator

maintainers:
  - Eric Jeong <eric.jeong.opensource@diasemi.com>
  - Support Opensource <support.opensource@diasemi.com>

description: |
  The SLG51000 has seven LDOs; the SLG51002 has eight, and pairs LDO1 and LDO2
  on a shared input pin. The SLG51002 also has four GPIO outputs that boards
  use as load-switch enables; they are described as on/off regulators.

properties:
  compatible:
    enum:
      - dlg,slg51000
      - dlg,slg51002

  reg:
    maxItems: 1

  interrupts:
    maxItems: 1

  dlg,cs-gpios:
    maxItems: 1
    description:
      GPIO for chip select

  dlg,bb-gpios:
    maxItems: 1
    description:
      GPIO enabling the buck-boost converter that feeds the LDO inputs. It is
      raised before chip select.

  dlg,buck-gpios:
    maxItems: 1
    description:
      GPIO enabling the buck converter that feeds the LDO inputs. It is
      raised after dlg,bb-gpios and before chip select.

  vin1_2-supply:
    description:
      Input supply shared by ldo1 and ldo2, required if either is enabled

  vin3-supply:
    description:
      Input supply for ldo3, required if regulator is enabled

  vin4-supply:
    description:
      Input supply for ldo4, required if regulator is enabled

  vin5-supply:
    description:
      Input supply for ldo5, required if regulator is enabled

  vin6-supply:
    description:
      Input supply for ldo6, required if regulator is enabled

  vin7-supply:
    description:
      Input supply for ldo7, required if regulator is enabled

  vin8-supply:
    description:
      Input supply for ldo8, required if regulator is enabled

  regulators:
    type: object
    additionalProperties: false

    patternProperties:
      "^ldo[1-8]$":
        type: object
        $ref: /schemas/regulator/regulator.yaml#
        unevaluatedProperties: false

        properties:
          enable-gpios:
            maxItems: 1

        required:
          - regulator-name

      "^gpio[1-4]$":
        type: object
        $ref: /schemas/regulator/regulator.yaml#
        unevaluatedProperties: false
        description:
          GPIO output used as an on/off load-switch enable

        required:
          - regulator-name

required:
  - compatible
  - reg
  - regulators

allOf:
  - if:
      properties:
        compatible:
          const: dlg,slg51000
    then:
      properties:
        dlg,bb-gpios: false
        dlg,buck-gpios: false
        vin1_2-supply: false
        vin8-supply: false
        regulators:
          patternProperties:
            "^gpio[1-4]$": false
          properties:
            ldo8: false

additionalProperties: false

examples:
  - |
    #include <dt-bindings/gpio/gpio.h>
    #include <dt-bindings/interrupt-controller/irq.h>
    #include <dt-bindings/regulator/dlg,da9121-regulator.h>
    i2c {
        #address-cells = <1>;
        #size-cells = <0>;

        pmic@75 {
            compatible = "dlg,slg51000";
            reg = <0x75>;
            dlg,cs-gpios = <&tlmm 69 GPIO_ACTIVE_HIGH>;
            vin5-supply = <&vreg_s1f_1p2>;
            vin6-supply = <&vreg_s1f_1p2>;

            regulators {
                ldo1 {
                    regulator-name = "slg51000_b_ldo1";
                    regulator-min-microvolt = <2400000>;
                    regulator-max-microvolt = <3300000>;
                };

                ldo2 {
                    regulator-name = "slg51000_b_ldo2";
                    regulator-min-microvolt = <2400000>;
                    regulator-max-microvolt = <3300000>;
                };

                ldo3 {
                    regulator-name = "slg51000_b_ldo3";
                    regulator-min-microvolt = <1200000>;
                    regulator-max-microvolt = <3750000>;
                };

                ldo4 {
                    regulator-name = "slg51000_b_ldo4";
                    regulator-min-microvolt = <1200000>;
                    regulator-max-microvolt = <3750000>;
                };

                ldo5 {
                    regulator-name = "slg51000_b_ldo5";
                    regulator-min-microvolt = <500000>;
                    regulator-max-microvolt = <1200000>;
                };

                ldo6 {
                    regulator-name = "slg51000_b_ldo6";
                    regulator-min-microvolt = <500000>;
                    regulator-max-microvolt = <1200000>;
                };

                ldo7 {
                    regulator-name = "slg51000_b_ldo7";
                    regulator-min-microvolt = <1200000>;
                    regulator-max-microvolt = <3750000>;
                };
            };
        };
    };

  - |
    #include <dt-bindings/gpio/gpio.h>
    i2c {
        #address-cells = <1>;
        #size-cells = <0>;

        pmic@75 {
            compatible = "dlg,slg51002";
            reg = <0x75>;
            dlg,cs-gpios = <&pmic_gpio 0 GPIO_ACTIVE_HIGH>;
            dlg,bb-gpios = <&pmic_gpio 1 GPIO_ACTIVE_HIGH>;
            dlg,buck-gpios = <&pmic_gpio 3 GPIO_ACTIVE_HIGH>;

            regulators {
                ldo8 {
                    regulator-name = "cam_ldo8";
                    regulator-min-microvolt = <970000>;
                    regulator-max-microvolt = <970000>;
                };

                gpio3 {
                    regulator-name = "cam_gpio3";
                };
            };
        };
    };
```

## drivers/interconnect/samsung/Kconfig
```kconfig
# SPDX-License-Identifier: GPL-2.0-only
config INTERCONNECT_SAMSUNG
	bool "Samsung SoC interconnect drivers"
	depends on ARCH_EXYNOS || COMPILE_TEST
	help
	  Interconnect drivers for Samsung SoCs.

config INTERCONNECT_EXYNOS
	tristate "Exynos SoC generic interconnect driver"
	depends on INTERCONNECT_SAMSUNG
	default y if ARCH_EXYNOS
	help
	  Generic interconnect driver for Samsung Exynos SoCs (e.g. Exynos3250,
	  Exynos4210, Exynos4412, Exynos542x, Exynos5433).
	  Choose Y here only if you build for such Samsung SoC.

config INTERCONNECT_EXYNOS_BTS
	tristate "Exynos Bus Traffic Shaper interconnect driver"
	depends on INTERCONNECT_SAMSUNG
	depends on COMMON_CLK
	help
	  Interconnect provider for the Samsung Bus Traffic Shaper found in
	  Google Tensor SoCs. It programs per-master AXI quality of service and
	  converts aggregate bandwidth constraints into ACPM DVFS clock floors.

config INTERCONNECT_ZUMA
	tristate "Google Tensor G3 (zuma) memory interconnect driver"
	depends on INTERCONNECT_SAMSUNG
	depends on ARM_EXYNOS_BUS_DEVFREQ
	help
	  Interconnect provider for the memory (MIF) and CPU cluster
	  interconnect (DSU) buses of the Google Tensor G3. It aggregates the
	  CPU and GPU bandwidth votes and passes them to the buses' devfreq
	  devices as minimum frequencies.
```
